## defconfig
```kconfig
CONFIG_TARGET_x86=y
CONFIG_TARGET_x86_64=y
CONFIG_TARGET_x86_64_DEVICE_generic=y
CONFIG_GRUB_TITLE="ClearWrt"
CONFIG_VMDK_IMAGES=y
CONFIG_TARGET_KERNEL_PARTSIZE=64
CONFIG_TARGET_ROOTFS_PARTSIZE=960
CONFIG_DEVEL=y
CONFIG_EXTRA_OPTIMIZATION="-fno-plt -fno-semantic-interposition"
CONFIG_TARGET_OPTIONS=y
CONFIG_TARGET_OPTIMIZATION="-O3 -march=x86-64 -pipe"
CONFIG_IMAGEOPT=y
CONFIG_VERSIONOPT=y
CONFIG_VERSION_DIST="ClearWrt"
CONFIG_VERSION_NUMBER="1.0-20230112"
CONFIG_VERSION_HOME_URL="https://github.com/DevriesL/OpenWrt"
CONFIG_VERSION_FILENAMES=y

CONFIG_PACKAGE_block-mount=y
CONFIG_PACKAGE_ca-certificates=y
# CONFIG_PACKAGE_dnsmasq is not set
CONFIG_PACKAGE_dnsmasq-full=y
CONFIG_PACKAGE_firewall=y
# CONFIG_PACKAGE_firewall4 is not set
CONFIG_PACKAGE_libatomic=y
CONFIG_PACKAGE_libstdcpp=y
CONFIG_PACKAGE_resolveip=y
CONFIG_PACKAGE_rpcd=y
CONFIG_PACKAGE_htop=y
CONFIG_HTOP_LMSENSORS=y
CONFIG_PACKAGE_grub2-efi=y

CONFIG_PACKAGE_kmod-fs-exfat=y
CONFIG_PACKAGE_kmod-ip6tables=y
CONFIG_PACKAGE_kmod-ip6tables-extra=y
CONFIG_PACKAGE_kmod-ipt-fullconenat=y
CONFIG_PACKAGE_kmod-ipt-nat6=y
CONFIG_PACKAGE_kmod-ipt-offload=y
CONFIG_PACKAGE_kmod-ipt-raw=y
CONFIG_PACKAGE_kmod-nf-ipt6=y
CONFIG_PACKAGE_kmod-nf-nat6=y
CONFIG_PACKAGE_kmod-nf-nathelper=y
CONFIG_PACKAGE_kmod-nf-nathelper-extra=y
CONFIG_PACKAGE_kmod-macvlan=y
CONFIG_PACKAGE_kmod-mppe=y
CONFIG_PACKAGE_kmod-tun=y

CONFIG_PACKAGE_libiwinfo-lua=y
CONFIG_PACKAGE_lua=y
CONFIG_PACKAGE_libbpf=y
CONFIG_PACKAGE_libcares=y
CONFIG_PACKAGE_libcurl=y
CONFIG_PACKAGE_libfdisk=y
CONFIG_PACKAGE_libkmod=y
CONFIG_PACKAGE_libpci=y
CONFIG_PACKAGE_libpcre=y
CONFIG_PCRE_JIT_ENABLED=y
CONFIG_PACKAGE_libpcre2=y
CONFIG_PCRE2_JIT_ENABLED=y
CONFIG_PACKAGE_libreadline=y
CONFIG_PACKAGE_libsensors=y
CONFIG_PACKAGE_libubus-lua=y
CONFIG_PACKAGE_libuci-lua=y
CONFIG_PACKAGE_libudns=y
CONFIG_PACKAGE_rpcd-mod-rrdns=y
CONFIG_ZLIB_OPTIMIZE_SPEED=y

CONFIG_PACKAGE_luci=y
CONFIG_LUCI_LANG_en=y
CONFIG_LUCI_LANG_zh_Hans=y
CONFIG_PACKAGE_luci-app-ddns=y
CONFIG_PACKAGE_luci-app-mwan3=y
CONFIG_PACKAGE_luci-app-nlbwmon=y
CONFIG_PACKAGE_luci-app-openclash=y
CONFIG_PACKAGE_luci-app-statistics=y
CONFIG_PACKAGE_luci-app-ttyd=y
CONFIG_PACKAGE_luci-app-upnp=y
CONFIG_PACKAGE_luci-app-zerotier=y
CONFIG_PACKAGE_luci-theme-argon=y
CONFIG_PACKAGE_luci-lib-ipkg=y

CONFIG_PACKAGE_wget-ssl=y
CONFIG_PACKAGE_ip6tables-extra=y
CONFIG_PACKAGE_ip6tables-mod-nat=y
CONFIG_PACKAGE_iptables-mod-fullconenat=y
CONFIG_PACKAGE_ddns-scripts_aliyun=y
CONFIG_PACKAGE_ddns-scripts_dnspod=y
CONFIG_PACKAGE_zerotier=y
CONFIG_PACKAGE_ethtool=y
CONFIG_PACKAGE_vim=y
CONFIG_PACKAGE_libimobiledevice-utils=y
CONFIG_PACKAGE_libusbmuxd-utils=y
CONFIG_PACKAGE_usbmuxd=y
CONFIG_PACKAGE_bc=y
CONFIG_PACKAGE_collectd=y
CONFIG_PACKAGE_collectd-mod-thermal=y
CONFIG_PACKAGE_coreutils-base64=y
CONFIG_PACKAGE_pciids=y
CONFIG_PACKAGE_pciutils=y
CONFIG_PACKAGE_usbutils=y
```
